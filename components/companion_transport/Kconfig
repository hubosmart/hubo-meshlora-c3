## components/companion_transport/Kconfig
```kconfig
menu "Hubo companion transport"
    choice HUBO_TRANSPORT
        prompt "Active companion transport"
        default HUBO_TRANSPORT_USB
        config HUBO_TRANSPORT_USB
            bool "USB Serial/JTAG"
        config HUBO_TRANSPORT_BLE
            bool "NimBLE peripheral"
            depends on BT_NIMBLE_ENABLED
    endchoice
    config HUBO_BLE_ATT_TRACE
        bool "Trace BLE ATT response boundaries"
        depends on HUBO_TRANSPORT_BLE
        default n
        help
            Log ATT opcodes and SDK return codes only, without message bodies
            or bonding keys. Enable temporarily for reconnect diagnostics.
endmenu
```

## components/hubo_radio/Kconfig
```kconfig
menu "Hubo E22 radio"
    config HUBO_E22_SX1262_COMPAT
        bool "Use the measured SX1262-compatible E22 profile"
        default n
        help
            Enable only for an E22-400M30S verified to report SX1261
            and pass the SX1262-compatible receive probe. The module
            band and chip power limits still apply. Disabled selects SX1268.

    config HUBO_E22_RXEN_GPIO
        int "GPIO wired to the E22 RXEN pin"
        default 2
        help
            The standard board wires RXEN to GPIO2. The GNSS board
            moves RXEN to GPIO0 and repurposes GPIO2 as GPS_EN_N.

    config HUBO_GPS_EN_N_GPIO
        int "GPIO wired to the active-low GNSS power switch (-1 = none)"
        default -1
        help
            GNSS board: GPIO2 = GPS_EN_N, low powers the GNSS. The pin is driven high at
            start-up (GNSS off); the GNSS driver powers it on when the "gps" custom variable is 1.
endmenu
```

## main/Kconfig.projbuild
```kconfig
menu "Hubo hardware bring-up"
    config HUBO_HW_PROBE
        bool "Run the GNSS board bring-up probe at boot (debug builds only)"
        default n
        help
            After the mesh task starts, powers the GNSS (GPS_EN_N low), tries to talk to it over
            UART1 (GPIO20 RX / GPIO21 TX) and stores the result in the global g_hw_probe, which a
            JTAG debugger reads. Not for release builds.
endmenu
```
